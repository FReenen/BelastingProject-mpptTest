/**
 * @cliArgs --board "/ti/boards/CC3220S_LAUNCHXL" --product "simplelink_cc32xx_sdk@4_20_00_07"
 * @versions {"data":"2020052512","timestamp":"2020052512","tool":"1.5.0+1397","templates":"2020052512"}
 */

/**
 * Import the modules used in this configuration.
 */
const DriverLib = scripting.addModule("/ti/devices/DriverLib");
const Board     = scripting.addModule("/ti/drivers/Board");
const DMA       = scripting.addModule("/ti/drivers/DMA");
const GPIO      = scripting.addModule("/ti/drivers/GPIO", {}, false);
const GPIO1     = GPIO.addInstance();
const GPIO2     = GPIO.addInstance();
const GPIO3     = GPIO.addInstance();
const GPIO4     = GPIO.addInstance();
const GPIO5     = GPIO.addInstance();
const PWM       = scripting.addModule("/ti/drivers/PWM", {}, false);
const PWM1      = PWM.addInstance();
const Power     = scripting.addModule("/ti/drivers/Power");
const SPI       = scripting.addModule("/ti/drivers/SPI");
const SPI1      = SPI.addInstance();
const Watchdog  = scripting.addModule("/ti/drivers/Watchdog");
const Watchdog1 = Watchdog.addInstance();

/**
 * Write custom configuration values to the imported modules.
 */
GPIO1.$name            = "CONF_GPIO_NOODSTOP";
GPIO1.interruptTrigger = "Falling Edge";
GPIO1.pull             = "Pull Up";
GPIO1.mode             = "Dynamic";
GPIO1.callbackFunction = "noodstopISR";

GPIO2.$name            = "CONFIG_GPIO_INIT";
GPIO2.pull             = "Pull Down";
GPIO2.callbackFunction = "initISR";
GPIO2.interruptTrigger = "Rising Edge";
GPIO2.gpioPin.$assign  = "boosterpack.7";

GPIO3.$name            = "CONFIG_GPIO_START";
GPIO3.callbackFunction = "startSysISR";
GPIO3.interruptTrigger = "Both Edges";
GPIO3.gpioPin.$assign  = "boosterpack.4";

GPIO4.$name              = "CONFIG_GPIO_CSMSP";
GPIO4.mode               = "Output";
GPIO4.initialOutputState = "High";

GPIO5.$name              = "CONFIG_GPIO_CSADC";
GPIO5.mode               = "Output";
GPIO5.initialOutputState = "High";

PWM1.$name     = "CONFIG_PWM_0";
PWM1.$hardware = system.deviceData.board.components.LED_RED;

Power.ioRetentionShutdown = ["GRP_1"];
Power.parkPins.$name      = "ti_drivers_power_PowerCC32XXPins0";

SPI1.$name = "CONFIG_SPI_MASTER";

Watchdog1.$name            = "CONFIG_WATCHDOG_0";
Watchdog1.watchdog.$assign = "WATCHDOG0";

/**
 * Pinmux solution for unlocked pins/peripherals. This ensures that minor changes to the automatic solver in a future
 * version of the tool will not impact the pinmux you originally saw.  These lines can be completely deleted in order to
 * re-solve from scratch.
 */
GPIO1.gpioPin.$suggestSolution         = "boosterpack.18";
GPIO4.gpioPin.$suggestSolution         = "boosterpack.19";
GPIO5.gpioPin.$suggestSolution         = "boosterpack.13";
PWM1.timer.$suggestSolution            = "Timer2";
PWM1.timer.pwmPin.$suggestSolution     = "boosterpack.29";
SPI1.spi.$suggestSolution              = "SPI0";
SPI1.spi.sclkPin.$suggestSolution      = "boosterpack.17";
SPI1.spi.misoPin.$suggestSolution      = "boosterpack.14";
SPI1.spi.mosiPin.$suggestSolution      = "boosterpack.15";
SPI1.spi.dmaRxChannel.$suggestSolution = "UDMA_CH30";
SPI1.spi.dmaTxChannel.$suggestSolution = "UDMA_CH31";
